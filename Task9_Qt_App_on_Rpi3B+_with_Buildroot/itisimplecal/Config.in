## Task9_Qt_App_on_Rpi3B+_with_Buildroot/itisimplecal/Config.in
```kconfig
config BR2_PACKAGE_ITISIMPLECAL
	bool "itisimplecal"
	depends on BR2_PACKAGE_QT6
	depends on BR2_PACKAGE_QT6BASE_GUI
	depends on BR2_PACKAGE_QT6DECLARATIVE
	help
	  A simple Qt6 QML calculator by Abdelfattah.
```
